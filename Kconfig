## Kconfig
```kconfig
menu "OmegaChronoController Configuration"
    config OMEGA_CHRONO_CONTROLLER_DEBUG
        bool "Enable Chrono Controller Debug logs"
        default "n"
        help
            This is used to enable or disable debug logs
    config OMEGA_CHRONO_CONTROLLER_INFO
        bool "Enable Chrono Controller Info logs"
        default "n"
        help
            This is used to enable or disable info logs
    config OMEGA_CHRONO_CONTROLLER_WARN
        bool "Enable Chrono Controller Warn logs"
        default "n"
        help
            This is used to enable or disable warn logs
    config OMEGA_CHRONO_CONTROLLER_ERROR
        bool "Enable Chrono Controller Error logs"
        default "n"
        help
            This is used to enable or disable error logs
    config OMEGA_CHRONO_CONTROLLER_PROFILE
        bool "Enable Chrono Controller Profiling"
        default "n"
        help
            This is used to enable or disable profiling
endmenu
```
